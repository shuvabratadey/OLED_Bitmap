#include <Wire.h>
#include <Adafruit_GFX.h>
#include <Adafruit_SSD1306.h>
#include "images.h"
#include <Adafruit_Sensor.h>
#include <Adafruit_BME280.h>

#define SEALEVELPRESSURE_HPA (1013.25)

Adafruit_BME280 bme; // I2C

static const unsigned char PROGMEM image_humidity_bits[] = {0x00, 0x01, 0x80, 0x00, 0x00, 0x01, 0x80, 0x00, 0x00, 0x03, 0xc0, 0x00, 0x00,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 0xe0, 0x00};

static const unsigned char PROGMEM image_temperature_bits[] = {0x00, 0x38, 0x00, 0x00, 0x00, 0x6c, 0x00, 0x00, 0x00, 0xc6, 0x00, 0x00, 0x00,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 0x00, 0x00};

Adafruit_SSD1306 display(128, 64, &Wire, -1);

#define TIME_DELAY_MS 250

void Show_Temp_Humidity()
{
  display.setCursor(42, 10);
  display.print(bme.readTemperature());

  if (bme.readHumidity() < 100)
  {
    display.setCursor(53, 40);
  }
  else
  {
    display.setCursor(42, 40);
  }
  display.print((int)bme.readHumidity());
}

void setup() {
  Serial.begin(115200);
  if (!bme.begin(0x76))
  {
    Serial.println(F("BME280 failed"));
    for (;;)
      ;
  }
  if (!display.begin(SSD1306_SWITCHCAPVCC, 0x3C))
  {
    Serial.println(F("SSD1306 allocation failed"));
    for (;;)
      ;
  }
  display.setTextColor(1);
  display.setTextSize(2);
  display.setTextWrap(false);

  display.clearDisplay();
  display.display();
}

void loop() {
  for (int i = 0; i < BITMAP_ARRAY_LEN; i++)
  {
    display.clearDisplay();
    display.drawBitmap(78, 30, image_humidity_bits, 32, 32, 1);
    display.drawBitmap(97, 0, image_temperature_bits, 32, 32, 1);
    display.drawBitmap(4, 13, bitmap_panda[i], 32, 32, 1);
    Show_Temp_Humidity();
    display.display();
    delay(TIME_DELAY_MS);
  }
  for (int i = 0; i < BITMAP_ARRAY_LEN; i++)
  {
    display.clearDisplay();
    display.drawBitmap(78, 30, image_humidity_bits, 32, 32, 1);
    display.drawBitmap(97, 0, image_temperature_bits, 32, 32, 1);
    display.drawBitmap(4, 13, bitmap_panda[BITMAP_ARRAY_LEN - i - 1], 32, 32, 1);
    Show_Temp_Humidity();
    display.display();
    delay(TIME_DELAY_MS);
  }
}
